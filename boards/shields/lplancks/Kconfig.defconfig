## boards/shields/lplancks/dts/bindings/zmk,behavior-battery-printer.yaml
```yaml
compatible: "zmk,behavior-battery-printer"
description: "Minimal binding schema for a behavior that types battery percentage."
properties:
  "#binding-cells":
    type: integer
  label:
    type: string
```

## config/west.yml
```yaml
manifest:
  remotes:
    - name: zmkfirmware
      url-base: https://github.com/zmkfirmware
    - name: awkannan  # <-- new entry
      url-base: https://github.com/awkannan
  projects:
    - name: zmk # <-- modified entry
      remote: awkannan
      revision: develop
      import: app/west.yml
    - name: zmk-smart-rgbled-widget  # <-- new entry
      remote: awkannan
      revision: main
  self:
    path: config
```
