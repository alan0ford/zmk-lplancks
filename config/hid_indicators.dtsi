/ {
    hid_indicators {
        compatible = "zmk,hid-indicators";
        label = "HID Indicators";

        caps_lock {
            led = <&led_strip 0>;
            color = <255 255 255>; // Bianco
        };
    };
};

